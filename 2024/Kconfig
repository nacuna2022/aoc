## 2024/Kconfig
```kconfig
config 2024_D1
	bool "--- Day 1: Historian Hysteria ---"
	source 2024/day1/Kconfig

config 2024_D2
	bool "--- Day 2: Red-Nosed Reports ---"
	source 2024/day2/Kconfig

config 2024_D3
	bool "--- Day 3: Mull It Over ---"
	source 2024/day3/Kconfig

config 2024_D4
	bool "--- Day 4: Ceres Search ---"
	source 2024/day4/Kconfig

config 2024_D5
	bool "--- Day 5: Print Queue ---"
	source 2024/day5/Kconfig

config 2024_D6
	bool "--- Day 6: Guard Gallivant ---"
	source 2024/day6/Kconfig

config 2024_D7
	bool "--- Day 7: Bridge Repair ---"
	source 2024/day7/Kconfig

config 2024_D8
	bool "--- Day 8: Resonant Collinearity ---"
	source 2024/day8/Kconfig

config 2024_D9
	bool "--- Day 9: Disk Fragmenter ---"
	source 2024/day9/Kconfig

config 2024_D10
	bool "--- Day 10: Hoof It ---"
	source 2024/day10/Kconfig

config 2024_D11
	bool "--- Day 11: Plutonian Pebbles ---"
	source 2024/day11/Kconfig

config 2024_D12
	bool "--- Day 12: Garden Groups ---"
	source 2024/day12/Kconfig

config 2024_D13
	bool "--- Day 13: Claw Contraption ---"
	source 2024/day13/Kconfig

config 2024_D14
	bool "--- Day 14: Restroom Redoubt ---"
	source 2024/day14/Kconfig
```

## 2024/day1/Kconfig
```kconfig
config 2024_D1P1
	bool "Part 1"
	depends on 2024_D1

config 2024_D1P2
	bool "Part 2"
	depends on 2024_D1
```

## 2024/day10/Kconfig
```kconfig
config 2024_D10P1
	bool "Part 1"
	select INPUT_CACHE
	depends on 2024_D10

config 2024_D10P2
	bool "Part 2"
	depends on 2024_D10
```

## 2024/day11/Kconfig
```kconfig
config 2024_D11P1
	bool "Part 1"
	depends on 2024_D11

config 2024_D11P2
	bool "Part 2"
	depends on 2024_D11
```

## 2024/day12/Kconfig
```kconfig
config 2024_D12P1
	bool "Part 1"
	depends on 2024_D12

config 2024_D12P2
	bool "Part 2"
	depends on 2024_D12
```

## 2024/day13/Kconfig
```kconfig
config 2024_D13P1
	bool "Part 1"
	depends on 2024_D13

config 2024_D13P2
	bool "Part 2"
	depends on 2024_D13
```

## 2024/day14/Kconfig
```kconfig
config 2024_D14P1
	bool "Part 1"
	depends on 2024_D14

config 2024_D14P2
	bool "Part 2"
	depends on 2024_D14
```

## 2024/day15/Kconfig
```kconfig
config 2024_D15P1
	bool "Part 1"
	depends on 2024_D15

config 2024_D15P2
	bool "Part 2"
	depends on 2024_D15
```

## 2024/day16/Kconfig
```kconfig
config 2024_D16P1
	bool "Part 1"
	depends on 2024_D16

config 2024_D16P2
	bool "Part 2"
	depends on 2024_D16
```

## 2024/day2/Kconfig
```kconfig
config 2024_D2P1
	bool "Part 1"
	depends on 2024_D2

config 2024_D2P2
	bool "Part 2"
	depends on 2024_D2
```

## 2024/day3/Kconfig
```kconfig
config 2024_D3P1
	bool "Part 1"
	depends on 2024_D3

config 2024_D3P2
	bool "Part 2"
	depends on 2024_D3
```

## 2024/day4/Kconfig
```kconfig
config 2024_D4P1
	bool "Part 1"
	depends on 2024_D4

config 2024_D4P2
	bool "Part 2"
	depends on 2024_D4
```

## 2024/day5/Kconfig
```kconfig
config 2024_D5P1
	bool "Part 1"
	depends on 2024_D5

config 2024_D5P2
	bool "Part 2"
	depends on 2024_D5
```

## 2024/day6/Kconfig
```kconfig
config 2024_D6P1
	bool "Part 1"
	depends on 2024_D6

config 2024_D6P2
	bool "Part 2"
	depends on 2024_D6
```

## 2024/day7/Kconfig
```kconfig
config 2024_D7P1
	bool "Part 1"
	depends on 2024_D7

config 2024_D7P2
	bool "Part 2"
	depends on 2024_D7
```

## 2024/day8/Kconfig
```kconfig
config 2024_D8P1
	bool "Part 1"
	depends on 2024_D8

config 2024_D8P2
	bool "Part 2"
	depends on 2024_D8
```

## 2024/day9/Kconfig
```kconfig
config 2024_D9P1
	bool "Part 1"
	depends on 2024_D9

config 2024_D9P2
	bool "Part 2"
	depends on 2024_D9
```

## Kconfig
```kconfig
mainmenu "Niel Acuna Advent of Code"

menu "AOC 2024"
source 2024/Kconfig
endmenu
```

## libs/Kconfig
```kconfig
config INPUT_CACHE
	bool "Input Cache"

config LINE_CACHE
	bool "Line Cache"
	select INPUT_CACHE

config MAP_CACHE
	bool "Map Cache"
	select INPUT_CACHE
```
